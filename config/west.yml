## config/west.yml
```yaml
manifest:
  remotes:
    - name: zmkfirmware
      url-base: https://github.com/zmkfirmware
    - name: kumamuk-git
      url-base: https://github.com/kumamuk-git
    - name: cormoran
      url-base: https://github.com/cormoran
  projects:
    # ZMK v0.3 + 非公式Studioカスタム通信（トラックボール設定アプリ用）
    - name: zmk
      remote: cormoran
      revision: 35bb5dafecd5931c432c74e1b630cf12097671e4 # v0.3+custom-studio-protocol
      import:
        file: app/west.yml
    - name: zmk-pmw3610-driver
      remote: kumamuk-git
      revision: main
  self:
    path: config
```

## modules/host-layer/Kconfig
```kconfig
config ROBA_HOST_LAYER
    bool "接続先（PC／スマホ）に合わせてキーマップのレイヤーを自動で切り替える"
    default n
    depends on !ZMK_SPLIT || ZMK_SPLIT_ROLE_CENTRAL

if ROBA_HOST_LAYER

config ROBA_HOST_LAYER_PHONE_PROFILE
    int "スマホを登録した Bluetooth プロファイル番号（0〜4）"
    default 2

config ROBA_HOST_LAYER_PHONE_LAYER
    int "スマホ用キーマップのレイヤー番号"
    default 1

endif
```
